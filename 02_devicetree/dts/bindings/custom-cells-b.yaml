## 02_devicetree/dts/bindings/custom-cells-b.yaml
```yaml
# SPDX-License-Identifier: BSD-3-Clause

description: Dummy for matching "cells"

compatible: "custom-cells-b"

phandle-array-of-ref-cells:
  - name-of-cell-one
```

## 02_devicetree/dts/bindings/custom-props-phandles.yaml
```yaml
# SPDX-License-Identifier: BSD-3-Clause

description: Custom properties

compatible: "custom-props-phandles"

properties:

  path-by-path:
    type: path

  path-by-label:
    type: path

  phandle-by-path:
    type: phandle

  phandle-by-label:
    type: phandle

  phandles:
    type: phandles

  # Notice how the property name _must_ end in an "s"
  # Expects a mix of phandles and numbers.
  phandle-array-of-refs:
    type: phandle-array


  # nonexistent-boolean:
  #   type: boolean

  # existent-boolean:
  #   type: boolean

  # int:
  #   type: int
  #   const: 1

  # array:
  #   type: array

  # uint8-array:
  #   type: uint8-array

  # string:
  #   type: string
  #   const: "foo"

  # string-array:
  #   type: string-array
  #   const: ['foo', 'bar', 'baz']

  # phandle-ref:
  #   type: phandle

  # phandle-refs:
  #   type: phandles

  # phandle-array-foos:
  #   type: phandle-array

  # phandle-array-foo-names:
  #   type: string-array

  # # There's some slight special-casing for GPIOs in that 'foo-gpios = ...'
  # # gets resolved to #gpio-cells rather than #foo-gpio-cells, so test that
  # # too
  # foo-gpios:
  #   type: phandle-array

  # path:
  #   type: path
```

## 03_devicetree_semantics/dts/bindings/custom-cells-a.yaml
```yaml
description: Dummy for matching "cells"
compatible: "custom-cells-a"

properties:
  dummy-value:
    type: int

# This list serves as names for the cells.
# The values of the cells can then be retrieved using the devicetree API, by cell name.
phandle-array-of-ref-cells:
  - name-of-cell-one
  - name-of-cell-two
```

## 03_devicetree_semantics/dts/bindings/custom-cells-b.yaml
```yaml
description: Dummy for matching "cells"
compatible: "custom-cells-b"

phandle-array-of-ref-cells:
  - name-of-cell-one
```

## 03_devicetree_semantics/dts/bindings/custom-props-basics.yaml
```yaml
description: Custom properties

# The following compatible key does not use the value "custom,props-basics"
# since the vendor "custom" doesn't exist in the vendor-prefixes.txt.
# The generation doesn't fail but it leads to the following message:
# compatible 'custom-props-basics' has unknown vendor prefix 'dummy'
compatible: "custom-props-basics"

properties:
  existent-boolean:
    type: boolean
  int:
    type: int
    required: true
  array:
    type: array
  uint8-array:
    type: uint8-array
  string:
    type: string
  string-array:
    type: string-array
  enum-int:
    type: int
    enum:
      - 100
      - 200
      - 300
  enum-string:
    type: string
    enum:
      - "whatever"
      - "works"
```

## 03_devicetree_semantics/dts/bindings/custom-props-phandles.yaml
```yaml
description: Custom properties
compatible: "custom-props-phandles"

properties:
  path-by-path:
    type: path
  path-by-label:
    type: path
  phandle-by-path:
    type: phandle
  phandle-by-label:
    type: phandle
  phandles:
    type: phandles

  # Notice how the property name _must_ end in an "s"
  # Expects a mix of phandles and numbers.
  phandle-array-of-refs:
    type: phandle-array
```
