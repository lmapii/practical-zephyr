## CMakeLists.txt
```
cmake_minimum_required(VERSION 3.20.0)
find_package(Zephyr REQUIRED HINTS $ENV{ZEPHYR_BASE})

project(
    EmptyApp
    VERSION 0.1
    DESCRIPTION "Dummy Kconfig Zephyr application."
    LANGUAGES C
)

target_sources(
    app
    PRIVATE
    src/main.c
)

# The following shows how Kconfig symbols can be used to include or exclude files from the build:
target_sources_ifdef(
    CONFIG_USR_FUN
    app
    PRIVATE
    src/usr_fun.c
)
```

## Kconfig
```
mainmenu "Customized Menu Name"
source "Kconfig.zephyr"

menu "Application Options"
config USR_FUN
	bool "Enable usr_fun"
	default n
	help
	  Enables the usr_fun function.
endmenu
```

## prj.conf
```kconfig
# The file is used for default builds (no CONF_FILE option used).
CONFIG_PRINTK=n
CONFIG_BOOT_BANNER=n
CONFIG_USR_FUN=y
```

## extra0.conf
```kconfig
# This fragment is intended to be used with the EXTRA_CONF_FILE option.
# A better name for this file in an actual project could be, e.g, `no-debug.conf`
CONFIG_DEBUG=n
```

## extra1.conf
```kconfig
# This fragment is intended to be used with the EXTRA_CONF_FILE option.
# A better name for this file in an actual project could be, e.g, `no-gpio.conf`
CONFIG_GPIO=n
```

## prj_release.conf
```kconfig
# The following symbols are some of the settings that are currently recommended
# by the hardening tool https://docs.zephyrproject.org/latest/security/hardening-tool.html
# This file is used for builds with CONF_FILE=prj_release.conf
CONFIG_LOG=n
CONFIG_PRINTK=n
CONFIG_BOOT_BANNER=n
CONFIG_EARLY_CONSOLE=n
CONFIG_OVERRIDE_FRAME_POINTER_DEFAULT=y
CONFIG_USE_SEGGER_RTT=n
CONFIG_BUILD_OUTPUT_STRIPPED=y
CONFIG_FAULT_DUMP=0
CONFIG_STACK_SENTINEL=y

# Kconfig symbols are also used to set compiler optimizations. E.g., the following symbol optimizes
# the build for size using the compiler flag "-Os". You should therefore not modify the compiler
# flags in your CMake configuration, but use Kconfig instead.
# See also, https://docs.zephyrproject.org/latest/kconfig.html#CONFIG_COMPILER_OPTIMIZATIONS
CONFIG_SIZE_OPTIMIZATIONS=y
```

## boards/nrf52840dk_nrf52840.conf
```kconfig
# 'prj_<board>.conf' files are deprecated and should be replaced with board
# Kconfig fragments instead. This file, placed in /boards, is such a fragment.
# The file will be automatically included for default builds (no CONF_FILE option used)
# if the application is built for the nRF52840 development kit.
CONFIG_UART_CONSOLE=n
```

## boards/nrf52840dk_nrf52840_release.conf
```kconfig
# This file will be automatically included for builds with CONF_FILE=prj_release.conf
# if the application is built for the nRF52840 development kit.
CONFIG_CONSOLE=n
CONFIG_UART_CONSOLE=n
```

## src/main.c
```c
/** \file main.c */

#include <zephyr/kernel.h>

#ifdef CONFIG_USR_FUN
#include "usr_fun.h"
#endif

#define SLEEP_TIME_MS 100U

int main(void)
{
    printk("Message in a bottle.\n");

#ifdef CONFIG_USR_FUN
    usr_fun();
#endif

    while (1)
    {
        k_msleep(SLEEP_TIME_MS);
    }
}
```

## src/usr_fun.c
```c
#include "usr_fun.h"

#include <zephyr/kernel.h>

void usr_fun(void)
{
    printk("Message in a user function.\n");
}
```

## src/usr_fun.h
```c
#pragma once

void usr_fun(void);
```
